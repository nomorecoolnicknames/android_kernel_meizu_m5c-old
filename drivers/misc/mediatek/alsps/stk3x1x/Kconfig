## drivers/misc/mediatek/alsps/stk3x1x/Kconfig
```kconfig
config MTK_STK3X1X
	bool "STK3X1X for MediaTek package"
	default n
	help
	  Sensortek STK3X1X ambient light / proximity sensor.
	  forge (m5c): this Kconfig declared MTK_STK3X1X_NEW while
	  alsps/Makefile maps MTK_STK3X1X to this directory (and
	  MTK_STK3X1X_NEW to a stk3x1x-new/ directory that does not exist in
	  this tree), so the symbol could never build the driver. Renamed to
	  match the Makefile. Stock m5c binds "stk3x1x" on alsps@48.
```
